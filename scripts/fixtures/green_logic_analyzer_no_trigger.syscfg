/**
 * @cliArgs --device "AM243x_ALV_beta" --package "ALV" --part "ALV" --context "icss_g0_pru0" --product "PRU_NO_CODE_TOOL@01.00.01" --product "MCU_PLUS_SDK_AM243x@11.01.00"
 */
const A=(n)=>scripting.addModule("/pru_blocks/pru_io_blocks/"+n).addInstance();
// Green arm: triggerSlope none never reads the trigger pin, so PWM on it is fine.
const l=A("../utils/logic_analyzer_block"); l.$name="LA"; l.triggerPin=2; l.triggerSlope="none";
const w=A("pwm_block"); w.$name="PWM"; w.pin="2";
