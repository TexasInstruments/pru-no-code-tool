/**
 * @cliArgs --device "AM243x_ALV_beta" --package "ALV" --part "ALV" --context "icss_g0_pru0" --product "PRU_NO_CODE_TOOL@01.00.01" --product "MCU_PLUS_SDK_AM243x@11.01.00"
 */
const A=(n)=>scripting.addModule("/pru_blocks/pru_io_blocks/"+n).addInstance();
// Green arm: capture with the IEP trigger (default) never reads R31, so pin 9 is free for PWM.
const c=A("capture_block"); c.$name="CAP"; c.pin="9"; c.triggerSource="iep";
const w=A("pwm_block"); w.$name="PWM"; w.pin="9";
