/**
 * @cliArgs --device "AM243x_ALV_beta" --package "ALV" --part "ALV" --context "icss_g0_pru0" --product "PRU_NO_CODE_TOOL@01.00.01" --product "MCU_PLUS_SDK_AM243x@11.01.00"
 */
const A=(n)=>scripting.addModule("/pru_blocks/pru_io_blocks/"+n).addInstance();
// Red arm: capture triggered from GPIO reads R31 bit 9, which PWM drives.
const c=A("capture_block"); c.$name="CAP"; c.pin="9"; c.triggerSource="gpio";
const w=A("pwm_block"); w.$name="PWM"; w.pin="9";
