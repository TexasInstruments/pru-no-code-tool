/**
 * @cliArgs --device "AM243x_ALV_beta" --package "ALV" --part "ALV" --context "icss_g0_pru0" --product "PRU_NO_CODE_TOOL@01.00.01" --product "MCU_PLUS_SDK_AM243x@11.01.00"
 */
const A=(n)=>scripting.addModule("/pru_blocks/pru_io_blocks/"+n).addInstance();
// Red arm: 1-wire dataPin 9 vs a foreign GPI on 9.
const o=A("onewire_block"); o.$name="OW"; o.dataPin="9";
const p=A("pru_gpi_block"); p.$name="P"; p.constant1="R31, 1 << 9";
