/**
 * @cliArgs --device "AM243x_ALV_beta" --package "ALV" --part "ALV" --context "icss_g0_pru0" --product "PRU_NO_CODE_TOOL@01.00.01" --product "MCU_PLUS_SDK_AM243x@11.01.00"
 */
const A=(n)=>scripting.addModule("/pru_blocks/pru_io_blocks/"+n).addInstance();
// Red arm: a two-way pad shared by different protocols - 1-wire dataPin 9 + i2c sdaBit 9.
const o=A("onewire_block"); o.$name="OW"; o.dataPin="9";
const c=A("i2c_block"); c.$name="BUS"; c.sclBit="10"; c.sdaBit="9";
