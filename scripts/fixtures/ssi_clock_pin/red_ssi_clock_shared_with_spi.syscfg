/**
 *
 * @cliArgs --device "AM243x_ALX_beta" --part "ALX" --package "ALX" --context "icss_g0_pru0" --product "PRU_NO_CODE_TOOL@01.00.01"
 * @versions {"tool":"1.28.0+4712"}
 */

/**
 * Import the modules used in this configuration.
 */
const ssi_initiator_block      = scripting.addModule("/pru_blocks/application_specific/ssi_initiator_block", {}, false);
const ssi_initiator_block1     = ssi_initiator_block.addInstance();
const pru_blocks_static_module = scripting.addModule("/pru_blocks/common/pru_blocks_static_module");
const pru_spi_write            = scripting.addModule("/pru_blocks/pru_io_blocks/pru_spi_write", {}, false);
const pru_spi_write1           = pru_spi_write.addInstance();
const device_model_block       = scripting.addModule("/pru_blocks/utils/device_model_block", {}, false);
const device_model_block1      = device_model_block.addInstance();

/**
 * Write custom configuration values to the imported modules.
 */
ssi_initiator_block1.$name = "SSI_Encoder_Read";

pru_blocks_static_module.signalsToDisplay = ["0","2","3"];

pru_spi_write1.$name         = "PRU0_SPI_Write_0";
pru_spi_write1["SDO Signal"] = "2";
pru_spi_write1["CS Signal"]  = "3";
pru_spi_write1.packetSize    = 25;

device_model_block1.ssi_bits     = 25;
device_model_block1.ssi_position = 4321;
device_model_block1.$name        = "Encoder_Model";

/**
 * Connections between modules.
 */
scripting.connect(ssi_initiator_block1, "next", pru_spi_write1, "prev");
scripting.connect(ssi_initiator_block1, "output1", pru_spi_write1, "input1");

/**
 * (x,y) coordinates for modules that are displayed in a graph.
 */
ssi_initiator_block1.$position = [0,0];
pru_spi_write1.$position       = [120,0];
device_model_block1.$position  = [0,120];
