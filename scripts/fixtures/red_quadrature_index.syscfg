/**
 * @cliArgs --device "AM243x_ALV_beta" --package "ALV" --part "ALV" --context "icss_g0_pru0" --product "PRU_NO_CODE_TOOL@01.00.01" --product "MCU_PLUS_SDK_AM243x@11.01.00"
 */
const A=(n)=>scripting.addModule("/pru_blocks/pru_io_blocks/"+n).addInstance();
// Red arm: with useIndex on, Z (bit 2) is read, so PWM on 2 collides.
const q=A("quadrature_block"); q.$name="QEP"; q.aBit="0"; q.bBit="1"; q.zBit="2"; q.useIndex=true;
const w=A("pwm_block"); w.$name="PWM"; w.pin="2";
