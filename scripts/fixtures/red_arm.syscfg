/**
 * These arguments were used when this file was generated. They will be automatically applied on subsequent loads
 * via the GUI or CLI. Run CLI with '--help' for additional information on how to override these arguments.
 * @cliArgs --device "AM243x_ALV_beta" --package "ALV" --part "ALV" --context "icss_g0_pru0" --product "PRU_NO_CODE_TOOL@01.00.01" --product "MCU_PLUS_SDK_AM243x@11.01.00"
 */

const pru_spi_write1 = scripting.addModule("/pru_blocks/pru_io_blocks/pru_spi_write").addInstance();
const parallel_bus_block1 = scripting.addModule("/pru_blocks/pru_io_blocks/parallel_bus_block").addInstance();

pru_spi_write1.$name = "SPI_CS";
pru_spi_write1["Device Mode"] = "controller";
pru_spi_write1["CS Signal"] = "9";

parallel_bus_block1.$name = "Parallel_Bus";
parallel_bus_block1.dataPinsStr = "8,9,10,11,12,13,14,15";
parallel_bus_block1.direction = "read";
