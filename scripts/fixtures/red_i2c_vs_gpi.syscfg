/**
 * @cliArgs --device "AM243x_ALV_beta" --package "ALV" --part "ALV" --context "icss_g0_pru0" --product "PRU_NO_CODE_TOOL@01.00.01" --product "MCU_PLUS_SDK_AM243x@11.01.00"
 */
const A=(n)=>scripting.addModule("/pru_blocks/pru_io_blocks/"+n).addInstance();
// Red arm: i2c SDA (R30/R31 bit 9) must not hide a foreign GPI on the same pin.
const i=A("i2c_block"); i.$name="I2C"; i.sdaBit="9"; i.sclBit="10";
const p=A("pru_gpi_block"); p.$name="P"; p.constant1="R31, 1 << 9";
