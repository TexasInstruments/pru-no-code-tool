/**
 * @cliArgs --device "AM261x_ZFG" --part "AM2612" --package "ZFG" --context "icss_m1_pru1" --product "PRU_NO_CODE_TOOL@01.00.01"
 * @versions {"tool":"1.27.0+4565"}
 */

/**
 * Import the modules used in this configuration.
 */
const flow_control_block  = scripting.addModule("/pru_blocks/program_control/flow_control_block", {}, false);
const flow_control_block1 = flow_control_block.addInstance();
const pru_spi_read        = scripting.addModule("/pru_blocks/pru_io_blocks/pru_spi_read", {}, false);
const pru_spi_read1       = pru_spi_read.addInstance();

/**
 * Write custom configuration values to the imported modules.
 */
flow_control_block1.$name  = "Flow_Control_0";


pru_spi_read1.$name          = "PRU1_SPI_Read_0";
pru_spi_read1["SCLK Signal"] = "4";
pru_spi_read1["SDI Signal"]  = "5";
pru_spi_read1["CS Signal"]   = "6";
pru_spi_read1["Device Mode"] = "peripheral";
pru_spi_read1["SPI Mode"]    = "MODE3";
pru_spi_read1.packetSize     = 32;

/**
 * Connections between modules.
 */
scripting.connect(flow_control_block1, "prev", pru_spi_read1, "next");

/**
 * (x,y) coordinates for modules that are displayed in a graph.
 */
flow_control_block1.$position = [120,30];
pru_spi_read1.$position       = [-70,15];
