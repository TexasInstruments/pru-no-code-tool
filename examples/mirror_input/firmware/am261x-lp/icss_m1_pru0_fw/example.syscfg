/**
 * @cliArgs --device "AM261x_ZFG" --part "AM2612" --package "ZFG" --context "icss_m1_pru0" --product "PRU_NO_CODE_TOOL@01.00.01"
 * @versions {"tool":"1.27.0+4565"}
 */

/**
 * Import the modules used in this configuration.
 */
const pru_blocks_static_module = scripting.addModule("/pru_blocks/common/pru_blocks_static_module");
const load_constant_block      = scripting.addModule("/pru_blocks/data_handling/load_constant_block", {}, false);
const load_constant_block1     = load_constant_block.addInstance();
const conditional_block        = scripting.addModule("/pru_blocks/program_control/conditional_block", {}, false);
const conditional_block1       = conditional_block.addInstance();
const flow_control_block       = scripting.addModule("/pru_blocks/program_control/flow_control_block", {}, false);
const flow_control_block1      = flow_control_block.addInstance();
const flow_control_block2      = flow_control_block.addInstance();
const loop_block               = scripting.addModule("/pru_blocks/program_control/loop_block", {}, false);
const loop_block1              = loop_block.addInstance();
const pru_gpi_block            = scripting.addModule("/pru_blocks/pru_io_blocks/pru_gpi_block", {}, false);
const pru_gpi_block1           = pru_gpi_block.addInstance();
const pru_gpo_block            = scripting.addModule("/pru_blocks/pru_io_blocks/pru_gpo_block", {}, false);
const pru_gpo_block1           = pru_gpo_block.addInstance();
const pru_gpo_block2           = pru_gpo_block.addInstance();

/**
 * Write custom configuration values to the imported modules.
 */
pru_blocks_static_module.pruClkFreq = 225;

load_constant_block1.$name = "Load_Constant_0";

conditional_block1.$name            = "If_Else_0";
conditional_block1.conditionToCheck = "equalToInput2";

flow_control_block1.$name      = "Flow_Control_0";
flow_control_block1.jumpTarget = "startloop_0";

flow_control_block2.$name      = "Flow_Control_1";
flow_control_block2.jumpTarget = "startloop_0";

loop_block1.$name        = "Loop_0";
loop_block1.infiniteLoop = true;
loop_block1.$size        = [690,375];

pru_gpi_block1.$name = "PRU0_GPI_INSTANCE_0";

pru_gpo_block1.$name     = "PRU0_GPO_INSTANCE_0";
pru_gpo_block1.constant1 = "R30, 1";

pru_gpo_block2.$name     = "PRU0_GPO_INSTANCE_1";
pru_gpo_block2.constant1 = "R30, 1";
pru_gpo_block2.opCode    = "CLR";

/**
 * References between modules.
 */
loop_block1.$groupContents = [pru_gpi_block1, conditional_block1, load_constant_block1, pru_gpo_block1, pru_gpo_block2, flow_control_block1, flow_control_block2];

/**
 * Connections between modules.
 */
scripting.connect(load_constant_block1, "output1", conditional_block1, "input2");
scripting.connect(conditional_block1, "input1", pru_gpi_block1, "output1");
scripting.connect(conditional_block1, "T", pru_gpo_block2, "prev");
scripting.connect(conditional_block1, "F", pru_gpo_block1, "prev");
scripting.connect(flow_control_block1, "prev", pru_gpo_block1, "next");
scripting.connect(flow_control_block2, "prev", pru_gpo_block2, "next");

/**
 * (x,y) coordinates for modules that are displayed in a graph.
 */
load_constant_block1.$position = [70,205];
conditional_block1.$position   = [195,105];
flow_control_block1.$position  = [445,155];
flow_control_block2.$position  = [430,50];
loop_block1.$position          = [0,0];
pru_gpi_block1.$position       = [75,110];
pru_gpo_block1.$position       = [315,165];
pru_gpo_block2.$position       = [310,70];
