/**
 * These arguments were used when this file was generated. They will be automatically applied on subsequent loads
 * via the GUI or CLI. Run CLI with '--help' for additional information on how to override these arguments.
 * @cliArgs --device "AM243x_ALV_beta" --package "ALV" --part "ALV" --context "icss_g0_rtu_pru1" --product "PRU_NO_CODE_TOOL@01.00.01"
 * @versions {"tool":"1.20.0+3587"}
 */
 
/**
 * Import the modules used in this configuration.
 */
const flow_control_block  = scripting.addModule("/pru_blocks/program_control/flow_control_block", {}, false);
const flow_control_block1 = flow_control_block.addInstance();

/**
 * Write custom configuration values to the imported modules.
 */
flow_control_block1.$name  = "Flow_Control_0";
flow_control_block1.opCode = "HALT";

/**
 * (x,y) coordinates for modules that are displayed in a graph.
 */
flow_control_block1.$position = [0,0];