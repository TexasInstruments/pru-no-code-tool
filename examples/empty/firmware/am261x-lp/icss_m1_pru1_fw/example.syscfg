/**
 * These arguments were used when this file was generated. They will be automatically applied on subsequent loads
 * via the GUI or CLI. Run CLI with '--help' for additional information on how to override these arguments.
 * @cliArgs --device "AM261x_ZFG" --part "AM2612" --package "ZFG" --context "icss_m1_pru1" --product "PRU_NO_CODE_TOOL@01.00.01"
 * @v2CliArgs --device "AM2612" --package "NFBGA (ZFG)" --context "icss_m1_pru1" --product "PRU_NO_CODE_TOOL@01.00.01"
 * @versions {"tool":"1.27.0+4565"}
 */

/**
 * Import the modules used in this configuration.
 */
const flow_control_block  = scripting.addModule("/pru_blocks/program_control/flow_control_block", {}, false);
const flow_control_block1 = flow_control_block.addInstance();

/**
 * Write custom configuration values to the imported modules.
 */
flow_control_block1.$name  = "Flow_Control_0";
flow_control_block1.opCode = "HALT";

/**
 * (x,y) coordinates for modules that are displayed in a graph.
 */
flow_control_block1.$position = [-120,-60];
