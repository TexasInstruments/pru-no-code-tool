/**
 * @cliArgs --device "AM243x_ALX_beta" --part "ALX" --package "ALX" --context "icss_g0_pru0" --product "PRU_NO_CODE_TOOL@01.00.01"
 * @versions {"tool":"1.27.0+4565"}
 */

/**
 * Import the modules used in this configuration.
 */
const pru_blocks_static_module = scripting.addModule("/pru_blocks/common/pru_blocks_static_module");
const load_constant_block      = scripting.addModule("/pru_blocks/data_handling/load_constant_block", {}, false);
const load_constant_block1     = load_constant_block.addInstance();
const flow_control_block       = scripting.addModule("/pru_blocks/program_control/flow_control_block", {}, false);
const flow_control_block1      = flow_control_block.addInstance();
const pru_spi_write            = scripting.addModule("/pru_blocks/pru_io_blocks/pru_spi_write", {}, false);
const pru_spi_write1           = pru_spi_write.addInstance();

/**
 * Write custom configuration values to the imported modules.
 */
pru_blocks_static_module.signalsToDisplay = ["3","4","5"];

load_constant_block1.$name     = "Load_Constant_0";
load_constant_block1.constant1 = 2882382797;

flow_control_block1.$name  = "Flow_Control_0";
flow_control_block1.opCode = "HALT";

pru_spi_write1.$name                                    = "PRU_SPI_Write_0";
pru_spi_write1.packetSize                               = 32;
pru_spi_write1["sclk high pulse width (in PRU cycles)"] = 12;
pru_spi_write1["sclk low pulse width (in PRU cycles)"]  = 10;
pru_spi_write1["SDO Signal"]                            = "3";
pru_spi_write1["SCLK Signal"]                           = "4";
pru_spi_write1["CS Signal"]                             = "5";

/**
 * Connections between modules.
 */
scripting.connect(load_constant_block1, "output1", pru_spi_write1, "input1");
scripting.connect(flow_control_block1, "prev", pru_spi_write1, "next");

/**
 * (x,y) coordinates for modules that are displayed in a graph.
 */
load_constant_block1.$position = [-210,-110];
flow_control_block1.$position  = [140,-120];
pru_spi_write1.$position       = [-35,-110];
