/**
 * @cliArgs --device "AM243x_ALX_beta" --part "ALX" --package "ALX" --context "icss_g0_pru0" --product "PRU_NO_CODE_TOOL@01.00.01"
 * @versions {"tool":"1.27.0+4565"}
 */

/**
 * Import the modules used in this configuration.
 */
const load_constant_block   = scripting.addModule("/pru_blocks/data_handling/load_constant_block", {}, false);
const load_constant_block1  = load_constant_block.addInstance();
const group_block           = scripting.addModule("/pru_blocks/program_control/group_block", {}, false);
const group_block1          = group_block.addInstance();
const access_look_up_table  = scripting.addModule("/pru_blocks/utils/access_look_up_table", {}, false);
const access_look_up_table1 = access_look_up_table.addInstance();
const look_up_table         = scripting.addModule("/pru_blocks/utils/look_up_table", {}, false);
const look_up_table1        = look_up_table.addInstance();

/**
 * Write custom configuration values to the imported modules.
 */
load_constant_block1.$name     = "binary_index";
load_constant_block1.constant1 = 5;

group_block1.$name     = "gray_encoder";
group_block1.groupName = "gray_encoder";

access_look_up_table1.$name        = "gray_encode";
access_look_up_table1.lutReference = "gray_encoder_lut";

look_up_table1.$name       = "gray_encoder_lut";
look_up_table1.initPattern = "manual";
look_up_table1.tableData   = "0,1,3,2,6,7,5,4,12,13,15,14,10,11,9,8";

/**
 * References between modules.
 */
group_block1.$groupContents = [load_constant_block1, access_look_up_table1];

/**
 * Connections between modules.
 */
scripting.connect(load_constant_block1, "output1", access_look_up_table1, "input1");
scripting.connect(load_constant_block1, "next", access_look_up_table1, "prev");

/**
 * (x,y) coordinates for modules that are displayed in a graph.
 */
group_block1.$position          = [0,0];
look_up_table1.$position        = [0,-150];
load_constant_block1.$position  = [40,80];
access_look_up_table1.$position = [220,80];
