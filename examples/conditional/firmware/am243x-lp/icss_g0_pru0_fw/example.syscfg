/**
 * @cliArgs --device "AM243x_ALX_beta" --part "ALX" --package "ALX" --context "icss_g0_pru0" --product "PRU_NO_CODE_TOOL@01.00.01"
 * @versions {"tool":"1.27.0+4565"}
 */

/**
 * Import the modules used in this configuration.
 */
const bitwise_block        = scripting.addModule("/pru_blocks/data_handling/bitwise_block", {}, false);
const bitwise_block1       = bitwise_block.addInstance();
const bitwise_block2       = bitwise_block.addInstance();
const load_constant_block  = scripting.addModule("/pru_blocks/data_handling/load_constant_block", {}, false);
const load_constant_block1 = load_constant_block.addInstance();
const load_constant_block2 = load_constant_block.addInstance();
const load_constant_block3 = load_constant_block.addInstance();
const load_constant_block4 = load_constant_block.addInstance();
const conditional_block    = scripting.addModule("/pru_blocks/program_control/conditional_block", {}, false);
const conditional_block1   = conditional_block.addInstance();

/**
 * Write custom configuration values to the imported modules.
 */
bitwise_block1.opCode = "OR";
bitwise_block1.$name  = "bit_set";

bitwise_block2.$name = "bit_clear";

load_constant_block1.$name     = "data_2";
load_constant_block1.constant1 = 2;

load_constant_block2.$name     = "data_1";
load_constant_block2.constant1 = 3;

load_constant_block3.constant1 = 2;
load_constant_block3.$name     = "bit_value";

load_constant_block4.constant1 = 255;
load_constant_block4.$name     = "original_data";

conditional_block1.$name            = "If_Else_0";
conditional_block1.conditionToCheck = "lessThanInput2";

/**
 * Connections between modules.
 */
scripting.connect(bitwise_block1, "input1", load_constant_block4, "output1");
scripting.connect(bitwise_block1, "input2", load_constant_block3, "output1");
scripting.connect(bitwise_block1, "prev", conditional_block1, "T");
scripting.connect(bitwise_block2, "input1", load_constant_block4, "output1");
scripting.connect(bitwise_block2, "input2", load_constant_block3, "output1");
scripting.connect(bitwise_block2, "prev", conditional_block1, "F");
scripting.connect(load_constant_block1, "output1", conditional_block1, "input2");
scripting.connect(load_constant_block2, "output1", conditional_block1, "input1");

/**
 * (x,y) coordinates for modules that are displayed in a graph.
 */
bitwise_block1.$position       = [465,5];
bitwise_block2.$position       = [465,160];
load_constant_block1.$position = [20,190];
load_constant_block2.$position = [20,120];
load_constant_block3.$position = [190,25];
load_constant_block4.$position = [195,-35];
conditional_block1.$position   = [195,165];
