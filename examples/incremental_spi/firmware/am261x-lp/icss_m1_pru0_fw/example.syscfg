/**
 * @cliArgs --device "AM261x_ZFG" --part "AM2612" --package "ZFG" --context "icss_m1_pru0" --product "PRU_NO_CODE_TOOL@01.00.01"
 * @versions {"tool":"1.27.0+4565"}
 */

/**
 * Import the modules used in this configuration.
 */
const arithmetic_block     = scripting.addModule("/pru_blocks/data_handling/arithmetic_block", {}, false);
const arithmetic_block1    = arithmetic_block.addInstance();
const load_constant_block  = scripting.addModule("/pru_blocks/data_handling/load_constant_block", {}, false);
const load_constant_block1 = load_constant_block.addInstance();
const load_constant_block2 = load_constant_block.addInstance();
const load_constant_block3 = load_constant_block.addInstance();
const conditional_block    = scripting.addModule("/pru_blocks/program_control/conditional_block", {}, false);
const conditional_block1   = conditional_block.addInstance();
const flow_control_block   = scripting.addModule("/pru_blocks/program_control/flow_control_block", {}, false);
const flow_control_block1  = flow_control_block.addInstance();
const flow_control_block2  = flow_control_block.addInstance();
const loop_block           = scripting.addModule("/pru_blocks/program_control/loop_block", {}, false);
const loop_block1          = loop_block.addInstance();

/**
 * Write custom configuration values to the imported modules.
 */
arithmetic_block1.$name = "Arithmetic_0";

load_constant_block1.$name = "Load_Constant_0";

load_constant_block2.$name     = "Load_Constant_1";
load_constant_block2.constant1 = 1;

load_constant_block3.$name     = "Load_Constant_2";
load_constant_block3.constant1 = 5;

conditional_block1.$name = "If_Else_0";

flow_control_block1.$name = "exit";

flow_control_block2.jumpTarget = "Loop_0_start";
flow_control_block2.$name      = "continue";

loop_block1.$name         = "Loop_0";
loop_block1.loopCount     = 15;
loop_block1.preInitBlocks = ["Load_Constant_0"];
loop_block1.$size         = [570,340];

/**
 * References between modules.
 */
loop_block1.$groupContents = [load_constant_block1, load_constant_block2, arithmetic_block1, conditional_block1, load_constant_block3, flow_control_block1, flow_control_block2];

/**
 * Connections between modules.
 */
scripting.connect(arithmetic_block1, "input1", load_constant_block1, "output1");
scripting.connect(arithmetic_block1, "input2", load_constant_block2, "output1");
scripting.connect(arithmetic_block1, "output1", conditional_block1, "input1");
scripting.connect(load_constant_block3, "output1", conditional_block1, "input2");
scripting.connect(conditional_block1, "T", flow_control_block1, "prev");
scripting.connect(conditional_block1, "F", flow_control_block2, "prev");

/**
 * (x,y) coordinates for modules that are displayed in a graph.
 */
arithmetic_block1.$position    = [205,100];
load_constant_block1.$position = [60,65];
load_constant_block2.$position = [65,165];
load_constant_block3.$position = [220,220];
conditional_block1.$position   = [330,155];
flow_control_block1.$position  = [410,90];
flow_control_block2.$position  = [420,210];
loop_block1.$position          = [0,0];
