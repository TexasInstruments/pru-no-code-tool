/**
 * @cliArgs --device "AM243x_ALX_beta" --part "ALX" --package "ALX" --context "icss_g0_pru0" --product "PRU_NO_CODE_TOOL@01.00.01"
 * @versions {"tool":"1.27.0+4565"}
 */

/**
 * Import the modules used in this configuration.
 */
const pru_blocks_static_module = scripting.addModule("/pru_blocks/common/pru_blocks_static_module");
const arithmetic_block     = scripting.addModule("/pru_blocks/data_handling/arithmetic_block", {}, false);
const arithmetic_block1    = arithmetic_block.addInstance();
const load_constant_block  = scripting.addModule("/pru_blocks/data_handling/load_constant_block", {}, false);
const load_constant_block1 = load_constant_block.addInstance();
const load_constant_block2 = load_constant_block.addInstance();
const flow_control_block   = scripting.addModule("/pru_blocks/program_control/flow_control_block", {}, false);
const flow_control_block1  = flow_control_block.addInstance();
const loop_block           = scripting.addModule("/pru_blocks/program_control/loop_block", {}, false);
const loop_block1          = loop_block.addInstance();
const pru_spi_write        = scripting.addModule("/pru_blocks/pru_io_blocks/pru_spi_write", {}, false);
const pru_spi_write1       = pru_spi_write.addInstance();

/**
 * Write custom configuration values to the imported modules.
 */
pru_blocks_static_module.signalsToDisplay = ["3","4","5"];

arithmetic_block1.$name = "Arithmetic_0";

load_constant_block1.$name = "Load_Constant_0";

load_constant_block2.$name     = "Load_Constant_1";
load_constant_block2.constant1 = 1;

flow_control_block1.$name = "Flow_Control_0";

loop_block1.$name         = "Loop_0";
loop_block1.loopCount     = 10;
loop_block1.preInitBlocks = ["Load_Constant_0"];
loop_block1.$size         = [500,315];

pru_spi_write1.$name          = "PRU0_SPI_Write_0";
pru_spi_write1["SDO Signal"]  = "3";
pru_spi_write1["CS Signal"]   = "5";
pru_spi_write1["SCLK Signal"] = "4";

/**
 * References between modules.
 */
loop_block1.$groupContents = [load_constant_block1, load_constant_block2, arithmetic_block1, pru_spi_write1];

/**
 * Connections between modules.
 */
scripting.connect(arithmetic_block1, "input1", load_constant_block1, "output1");
scripting.connect(arithmetic_block1, "input2", load_constant_block2, "output1");
scripting.connect(arithmetic_block1, "output1", pru_spi_write1, "input1");
scripting.connect(flow_control_block1, "prev", loop_block1, "next");

/**
 * (x,y) coordinates for modules that are displayed in a graph.
 */
arithmetic_block1.$position    = [185,75];
load_constant_block1.$position = [60,45];
load_constant_block2.$position = [60,130];
flow_control_block1.$position  = [145,15];
loop_block1.$position          = [0,0];
pru_spi_write1.$position       = [330,75];
